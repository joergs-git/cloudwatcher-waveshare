## main/Kconfig.projbuild
```kconfig
menu "CloudWatcher Configuration"

    config CW_WIFI_SSID
        string "WiFi SSID"
        default "MyNetwork"
        help
            WiFi network name to connect to.

    config CW_WIFI_PASSWORD
        string "WiFi Password"
        default "MyPassword"
        help
            WiFi network password.

    config CW_HOST_IP
        string "CloudWatcher IP Address"
        default "192.168.1.151"
        help
            IP address of the AAG CloudWatcher Solo device.

    config CW_HOST_PORT
        int "CloudWatcher HTTP Port"
        default 80
        help
            HTTP port of the CloudWatcher device.

    config CW_POLL_INTERVAL_S
        int "Current data poll interval (seconds)"
        default 60
        help
            How often to fetch current sensor data from lastData.pl.

    config CW_GRAPH_POLL_INTERVAL_S
        int "Graph data poll interval (seconds)"
        default 240
        help
            How often to fetch 24h graph data from graphData.pl.

endmenu

menu "Meteoblue Forecast Configuration"

    config MB_API_KEY
        string "Meteoblue API Key"
        default "JOHNDOE_API_KEY"
        help
            Your Meteoblue Forecast API key. Get one at https://www.meteoblue.com/en/weather-api

    config MB_API_SECRET
        string "Meteoblue API Secret (for signed keys)"
        default "JOHNDOE_SECRET"
        help
            Shared secret for Meteoblue API signature validation.
            The URL signature is: sig = MD5(path_and_query + "&secret=" + this_value)

    config MB_LATITUDE
        string "Latitude"
        default "52.17"
        help
            Latitude of your observatory location (decimal degrees).

    config MB_LONGITUDE
        string "Longitude"
        default "7.25"
        help
            Longitude of your observatory location (decimal degrees).

    config MB_ALTITUDE
        int "Altitude (meters)"
        default 40
        help
            Altitude of your observatory location in meters above sea level.

    config MB_POLL_INTERVAL_S
        int "Forecast poll interval (seconds)"
        default 3600
        help
            How often to fetch the Meteoblue cloud cover forecast.
            Default: 3600 (1 hour). Meteoblue model updates ~every 6h,
            so polling more often than 30 minutes is wasteful.

endmenu

menu "NINA Configuration"

    config NINA_HOST_IP
        string "NINA PC IP Address"
        default "192.168.1.114"
        help
            IP address of the imaging PC running N.I.N.A. with the Advanced API plugin.

    config NINA_HOST_PORT
        int "NINA API Port"
        default 1888
        help
            HTTP port of the ninaAPI Advanced API plugin.

    config NINA_DOME_PORT
        int "NINA Dome API Port"
        default 1888
        help
            HTTP port of the NINA instance controlling the dome (may differ from image instance).

    config DOME_CONTROLLER_IP
        string "Dome Controller IP Address"
        default "192.168.1.177"
        help
            IP address of the AstroShell dome Arduino controller (direct ASCOM query).

    config DOME_CONTROLLER_PORT
        int "Dome Controller Port"
        default 80
        help
            HTTP port of the AstroShell dome Arduino controller.

    config NINA_POLL_INTERVAL_S
        int "NINA image poll interval (seconds)"
        default 120
        help
            How often to fetch the latest image and dome status from NINA (default: 2 minutes).

    config DOME_CLOSE_CMD
        string "Dome Close All command path"
        default "/?$1$3"
        help
            HTTP GET path sent to AstroShell to close all shutters.

    config DOME_OPEN_CMD
        string "Dome Open All command path"
        default "/?$2$4"
        help
            HTTP GET path sent to AstroShell to open all shutters.

endmenu

menu "Pushover Notifications"

    config PUSHOVER_ENABLED
        bool "Enable Pushover notifications"
        default y
        help
            Send Pushover push notifications for dome open/close actions.

    config PUSHOVER_API_TOKEN
        string "Pushover API Token"
        default "REPLACE_WITH_TOKEN"
        help
            Pushover application API token. Do not commit real values to git.

    config PUSHOVER_USER_KEY
        string "Pushover User Key"
        default "REPLACE_WITH_USER_KEY"
        help
            Pushover user/group key. Do not commit real values to git.

endmenu
```
